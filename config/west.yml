## config/west.yml
```yaml
manifest:
  remotes:
    - name: zmkfirmware
      url-base: https://github.com/zmkfirmware
    - name: stephen/split-encoder
      url-base: https://github.com/petejohanson
  projects:
    - name: zmk
      remote: stephen/split-encoder
      revision: main
      import: app/west.yml
  self:
    path: config
```
